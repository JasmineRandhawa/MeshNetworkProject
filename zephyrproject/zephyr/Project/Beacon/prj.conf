## CMakeLists.txt
```
# SPDX-License-Identifier: Apache-2.0

cmake_minimum_required(VERSION 3.13.1)
find_package(Zephyr REQUIRED HINTS $ENV{ZEPHYR_BASE})
project(Beacon)

FILE(GLOB app_sources src/*.c)
target_sources(app PRIVATE ${app_sources})
```

## prj.conf
```kconfig
CONFIG_SYSTEM_WORKQUEUE_STACK_SIZE=4096
CONFIG_BT_RX_STACK_SIZE=4096

CONFIG_HEAP_MEM_POOL_SIZE=16384

CONFIG_BT=y
CONFIG_BT_CTLR=y

CONFIG_BT_DEVICE_NAME_DYNAMIC=y
CONFIG_BT_DEVICE_NAME_GATT_WRITABLE=y
CONFIG_BT_SMP=y
CONFIG_BT_PERIPHERAL=y
CONFIG_BT_PRIVACY=y
CONFIG_BT_DEVICE_NAME_MAX=32

CONFIG_BT_MESH_DEBUG=n
CONFIG_NEWLIB_LIBC=y

CONFIG_BT_SETTINGS=y
CONFIG_FLASH=y
CONFIG_FLASH_MAP=y
CONFIG_NVS=y
CONFIG_SETTINGS=y

CONFIG_BT_OBSERVER=y
CONFIG_BT_CTLR_DUP_FILTER_LEN=0
CONFIG_BT_CTLR_LE_ENC=n
CONFIG_BT_DATA_LEN_UPDATE=n
CONFIG_BT_PHY_UPDATE=n
CONFIG_BT_CTLR_CHAN_SEL_2=n
CONFIG_BT_CTLR_MIN_USED_CHAN=n
CONFIG_BT_CTLR_PRIVACY=n

CONFIG_BT_BROADCASTER=y
CONFIG_BT_TINYCRYPT_ECC=y
CONFIG_BT_L2CAP_RX_MTU=69
CONFIG_BT_L2CAP_TX_MTU=69
CONFIG_BT_L2CAP_TX_BUF_COUNT=5

CONFIG_BT_MESH=y
CONFIG_BT_MESH_MODEL_EXTENSIONS=y
CONFIG_BT_MESH_RELAY=y
CONFIG_BT_MESH_FRIEND=y
CONFIG_BT_MESH_PB_GATT=y
CONFIG_BT_MESH_PB_ADV=y
CONFIG_BT_MESH_GATT_PROXY=y

CONFIG_BT_MESH_SUBNET_COUNT=2
CONFIG_BT_MESH_APP_KEY_COUNT=2
CONFIG_BT_MESH_MODEL_GROUP_COUNT=2
CONFIG_BT_MESH_LABEL_COUNT=3

CONFIG_BT_DEBUG_LOG=n
CONFIG_BT_MESH_DEBUG=n
CONFIG_BT_MESH_DEBUG_NET=n
CONFIG_BT_MESH_DEBUG_TRANS=n
CONFIG_BT_MESH_DEBUG_SETTINGS=n
CONFIG_BT_MESH_DEBUG_FRIEND=n


CONFIG_BT_MESH_ADV_BUF_COUNT=30
CONFIG_BT_MESH_LABEL_COUNT=0
CONFIG_BT_MESH_CFG_CLI=y
CONFIG_BT_MESH_TX_SEG_MAX=6
CONFIG_BT_MESH_TX_SEG_MSG_COUNT=3
CONFIG_BT_MESH_RX_SEG_MSG_COUNT=3
CONFIG_BT_MESH_CRPL=128
CONFIG_BT_MESH_RPL_STORE_TIMEOUT=120
CONFIG_BT_MESH_MSG_CACHE_SIZE=30

CONFIG_PRINTK=y
CONFIG_SERIAL=y
CONFIG_CONSOLE=y
CONFIG_STDOUT_CONSOLE=y


CONFIG_I2C=y
CONFIG_GPIO=y
CONFIG_SENSOR=y

CONFIG_APDS9960=y

CONFIG_TI_HDC=y

CONFIG_FXOS8700=y
CONFIG_FXOS8700_MODE_ACCEL=y
CONFIG_FXOS8700_TRIGGER_OWN_THREAD=y
CONFIG_FXOS8700_MOTION=y

CONFIG_SPI=y
CONFIG_SPI_ASYNC=y

CONFIG_DISPLAY=y
CONFIG_SSD16XX=y

CONFIG_CHARACTER_FRAMEBUFFER=y
```

## src/main.c
```c
/*
 * Copyright (c) 2018 Intel Corporation
 *
 * SPDX-License-Identifier: Apache-2.0
 */

#include <zephyr.h>
#include <sys/printk.h>

#include <string.h>

#include <settings/settings.h>

#include "mesh.h"

void main(void)
{
	mesh_start();
}
```

## src/board.h
```c
#define STAT_COUNT 10

#if defined(CONFIG_SSD16XX)
#define DISPLAY_DRIVER "SSD16XX"
#else
#error Unsupported board
#endif

#if defined(CONFIG_SSD16XX)
#define DISPLAY_DRIVER "SSD16XX"
#endif

#if defined(CONFIG_SSD1306)
#define DISPLAY_DRIVER "SSD1306"
#endif

#ifndef DISPLAY_DRIVER
#define DISPLAY_DRIVER "DISPLAY"
#endif

enum font_size {
	FONT_SMALL = 0,
	FONT_MEDIUM = 1,
	FONT_BIG = 2,
};

void show_main(void);

/*board functions */
void board_show_text(const char *text, bool center);
void board_add_node_and_neighbours_data(uint16_t from_address, char * message_str , double distance, int16_t rssi);
void board_init(void);
void board_blink_leds(void);

/* sensor functions */
unsigned int get_temperature(void);
int get_humidity(void);
```

## src/mesh.c
```c
#include <zephyr.h>

#include <sys/printk.h>
#include <stdio.h>
#include <string.h>
#include <stdlib.h>
#include <math.h>

#include <bluetooth/bluetooth.h>
#include <bluetooth/mesh.h>

#include "mesh.h"
#include "board.h"

/*declare static variables */
static uint8_t my_device_uuid[16] = { 0xbb, 0xbb };
static uint16_t provisioner_address, my_address;
static char my_device_name[4], provisioner_device_name[2];
static bool is_message_recieved_from_prov = false;
static bool is_prov_complete = false;

/*compute distance in metres from RSSI value */
static double calculate_distance_in_metres(int8_t rssi)
{
	double default_tx = -59; // tx power of nrf52 chip is -59dm at 1m
	double env_factor = 2.7; //constant for environment factor . Range 2 to 4
	double exponent = (default_tx - rssi) / (10 * env_factor);
	double base = 10.0;
	double result = pow(base, exponent);
	return result;
}

/* receive message from a node */
static void receive_message(struct bt_mesh_model *model , struct bt_mesh_msg_ctx *ctx ,
		      		        struct net_buf_simple *buf , int8_t rssi)
{
	// If Sender address is my own address or unassigned address, return 
	if (ctx->addr == get_my_address() || ctx->addr== BT_MESH_ADDR_UNASSIGNED) 
		return;

	// extract message content		
	char message_str[32];
	size_t len =  MIN(buf->len, MSG_MAX_LEN);
	memcpy(message_str, buf->data, len);
	message_str[len] = '\0';
	printk("Received Message %s from 0x%04x \n\n", message_str, ctx->addr);
	
	// Compute distance in metres from RSSI  value 
	double distance  = calculate_distance_in_metres(rssi);
	
	// if distnace is less than 2 m , blink leds 
	if (distance < 2 ) 
		board_blink_leds();
	
	//acknowledge reception of provisioning message
	is_message_recieved_from_prov = true;

	// extract assigned device name and provisioner name from message string and save them to variables
	if(strstr(message_str,"Q")!=NULL) // Q is the mssage code for provisioning message
	{
		char msg_str[32];
		snprintf(msg_str, 32, "%s", message_str);

		// break "=" delimited message into tokens 
		char * msg_token = strtok(msg_str, "=");

		//extract provisioner device name
		msg_token = strtok(NULL, "=");
		snprintf(provisioner_device_name, 2, "%s", msg_token);
		msg_token = strtok(NULL, "=");

		//provisioner address as sender address
		provisioner_address = ctx->addr;

		//extract my device name
		snprintf(my_device_name, 4, "%s", msg_token);

		show_main();
	}
	
	// store the message information to the list
	board_add_node_and_neighbours_data(ctx->addr , message_str , distance , rssi);
}

static struct bt_mesh_cfg_cli cfg_cli = {
};

static struct bt_mesh_model root_models[] = {
	BT_MESH_MODEL_CFG_CLI(&cfg_cli),
	BT_MESH_MODEL_CFG_SRV,
};

static const struct bt_mesh_model_op vnd_ops[] = {
	{ OP_VND_MSG, 1, receive_message },
	BT_MESH_MODEL_OP_END,
};

static struct bt_mesh_model vnd_models[] = {
	BT_MESH_MODEL_VND(BT_COMP_ID_LF, MOD_LF, vnd_ops, NULL, NULL),
};

static struct bt_mesh_elem elements[] = {
	BT_MESH_ELEM(0, root_models, vnd_models),
};

static const struct bt_mesh_comp comp = {
	.cid = BT_COMP_ID_LF,
	.elem = elements,
	.elem_count = ARRAY_SIZE(elements),
};

/*get first word of message string */
static size_t get_first_word(const char * message_str)
{
	size_t len; 
	for (len = 0; * message_str; message_str++, len++)
	{
		switch (* message_str)
		{
		case ' ':
		case ',':
		case '\n':
			return len;
		}
	}
	return len;
}

/* send message to a node */
void send_message(uint16_t to_address , const char * message_str)
{
	// if to_address is my address or uassigned address, return
	if(to_address==get_my_address() || to_address==BT_MESH_ADDR_UNASSIGNED )
		return;

	//decklare message buffer of size 20
	NET_BUF_SIMPLE_DEFINE(buf, 3 + MSG_MAX_LEN + 4);
	struct bt_mesh_msg_ctx ctx = {
		.app_idx = APP_IDX,
		.addr = to_address,
		.send_ttl = DEFAULT_TTL,
	};
	bt_mesh_model_msg_init(&buf, OP_VND_MSG);
	net_buf_simple_add_mem(&buf, message_str, MIN(MSG_MAX_LEN, get_first_word(message_str)));
	if(bt_mesh_model_send(&vnd_models[0], &ctx, &buf, NULL, NULL)==0)
		printk("Sending Message %s to 0x%04x\n\n", message_str , to_address);
	else
		return;
}

/* callback function for provisioning complete */
static void prov_complete(uint16_t net_idx, uint16_t assigned_address)
{
	my_address = assigned_address;
	printk("Provisioning Complete \n");
	printk("Assigned Node Address: 0x%04x\n\n", assigned_address);
	is_prov_complete=true;
	show_main();
}

/* declare mesh profile */
static const struct bt_mesh_prov prov = {
	.uuid = my_device_uuid,
	.complete = prov_complete,
};

/* Initialize the Bluetooth Mesh Subsystem */
static void bt_ready(void)
{
	// Initialize the beacon device 
	printk("Initializing Device...\n");
	board_init();
	
	// print device info on serial log
	char device_uuid_str[8+1];
	bin2hex(get_my_device_uuid() , 2 , device_uuid_str, sizeof(device_uuid_str));
	printk("Device UUID:  %s \n\n", device_uuid_str);

	// print sensor info on serial log
	printk("Temperature : %d degree celsius \n", get_temperature());
	printk("Humidity : %d%% \n\n", get_humidity());

	// Intialize Bluetooth Mesh
	printk("Bluetooth initialized\n");
	printk("Mesh initialized\n\n");
	bt_mesh_init(&prov, &comp);
	
	// Load settings 
	if (IS_ENABLED(CONFIG_BT_SETTINGS)) {
		printk("Loading bluetooth stored settings\n");
		settings_load();
	}

	//enable advertising
	if(!is_prov_complete && !is_message_recieved_from_prov)
	{
		bt_mesh_prov_enable(BT_MESH_PROV_ADV | BT_MESH_PROV_GATT);
		printk("Advertising enabled\n");
		board_show_text("Advertising enabled\n\n" ,false);
	}
	else
		my_address = elements[0].addr;
	
	show_main();
}

/* start mesh operation */
void mesh_start(void)
{
	//intitialize variables
	my_address = BT_MESH_ADDR_UNASSIGNED;
	provisioner_address =  BT_MESH_ADDR_UNASSIGNED;
	is_message_recieved_from_prov = false;
	is_prov_complete = false;

	// Initialize Device, Bluetooth and Mesh 
	bt_enable(NULL);
	bt_ready();
}

/* get functions */
const uint8_t * get_my_device_uuid(void)
{
	return my_device_uuid;
}

uint16_t get_my_address(void)
{
	return my_address;
}

uint16_t get_provisioner_address(void)
{
	return provisioner_address;
}

char * get_my_device_name(void)
{
	return my_device_name;
}

char * get_provisioner_device_name(void)
{
	return provisioner_device_name;
}

/* mesh functions */
bool mesh_is_initialized(void)
{
	return elements[0].addr != BT_MESH_ADDR_UNASSIGNED;
}

bool mesh_is_prov_complete(void)
{
	return is_message_recieved_from_prov;;
}
```

## src/mesh.h
```c
#define MOD_LF            0x0000
#define APP_IDX           0x000
#define DEFAULT_TTL       31
#define MSG_MAX_LEN       12
#define OP_MSG        	  0xbb
#define OP_VND_MSG        BT_MESH_MODEL_OP_3(OP_MSG, BT_COMP_ID_LF)

/* get functions */
const uint8_t * get_my_device_uuid(void);
uint16_t get_my_address(void);
uint16_t get_provisioner_address(void);
char * get_my_device_name(void);
char * get_provisioner_device_name(void);

void send_message(uint16_t to_address, const char * message_str);

/* mesh functions */
bool mesh_is_initialized(void);
bool mesh_is_prov_complete(void);
void mesh_start(void);
```

## src/reel_board.c
```c
#include <zephyr.h>
#include <device.h>

#include <display/cfb.h>
#include <drivers/flash.h>
#include <storage/flash_map.h>
#include <drivers/gpio.h>
#include <drivers/sensor.h>

#include <sys/printk.h>
#include <string.h>
#include <stdio.h>
#include <stdlib.h>
#include <math.h>

#include <bluetooth/bluetooth.h>
#include <bluetooth/mesh/access.h>

#include "mesh.h"
#include "board.h"

static uint32_t record_count;
struct k_delayed_work led_timer;
static const struct device *epd_dev;

struct font_info {
	uint8_t columns;
} fonts[] = {
	[FONT_BIG] = { .columns = 12 },
	[FONT_MEDIUM] = { .columns = 14 },
	[FONT_SMALL] = { .columns = 26 },
};

/* declare stat list that contains all the mesh information */
static struct stat
{
	uint16_t addr;
	char name[3];
	int temperature;
	int humidity;
	uint16_t neighbour_addr;
	char neighbour_name[4];
	int neighbour_temperature;
	int neighbour_humidity;
	int8_t rssi;
	int8_t distance;
} node_info[STAT_COUNT] = {
	[0 ...(STAT_COUNT - 1)] = {},
};

static struct {
	const struct device *dev;
	const char *name;
	gpio_pin_t pin;
	gpio_flags_t flags;
} leds[] = { { .name = DT_GPIO_LABEL(DT_ALIAS(led0), gpios),
	       .pin = DT_GPIO_PIN(DT_ALIAS(led0), gpios),
	       .flags = DT_GPIO_FLAGS(DT_ALIAS(led0), gpios) },
	     { .name = DT_GPIO_LABEL(DT_ALIAS(led1), gpios),
	       .pin = DT_GPIO_PIN(DT_ALIAS(led1), gpios),
	       .flags = DT_GPIO_FLAGS(DT_ALIAS(led1), gpios) },
	     { .name = DT_GPIO_LABEL(DT_ALIAS(led2), gpios),
	       .pin = DT_GPIO_PIN(DT_ALIAS(led2), gpios),
	       .flags = DT_GPIO_FLAGS(DT_ALIAS(led2), gpios) } };

/* print line */
static size_t print_line(enum font_size font_size, int row, const char *text,
						 size_t len, bool center)
{
	uint8_t font_height, font_width;
	uint8_t line[fonts[FONT_SMALL].columns + 1];
	int pad;
	epd_dev = device_get_binding(DISPLAY_DRIVER);
	cfb_framebuffer_set_font(epd_dev, font_size);

	len = MIN(len, fonts[font_size].columns);
	memcpy(line, text, len);
	line[len] = '\0';

	if (center)
		pad = (fonts[font_size].columns - len) / 2U;
	else
		pad = 0;
	cfb_get_font_size(epd_dev, font_size, &font_width, &font_height);
	cfb_print(epd_dev, line, font_width * pad, font_height * row);
	return len;
}

/* get humidity sensor value from "ti_hdc" sample */
int get_humidity(void)
{
	const struct device *dev;
	struct sensor_value humidity;

	dev = device_get_binding(DT_LABEL(DT_INST(0, ti_hdc)));
	sensor_sample_fetch(dev);
	sensor_channel_get(dev, SENSOR_CHAN_HUMIDITY, &humidity);

	int humidity_value = (int)humidity.val1;
	return humidity_value;
}


/* get temperature sensor value from "ti_hdc" sample */
unsigned int get_temperature(void)
{
	const struct device *dev;
	struct sensor_value temp;

	dev = device_get_binding(DT_LABEL(DT_INST(0, ti_hdc)));
	sensor_sample_fetch(dev);
	sensor_channel_get(dev, SENSOR_CHAN_AMBIENT_TEMP, &temp);

	int temperature_value = (int)temp.val1;
	if (temperature_value < 0)
		temperature_value = 0;
	return temperature_value;
}

/* Display main screen info */
void show_main()
{
	char str[100];
	int len, line = 0;
	epd_dev = device_get_binding(DISPLAY_DRIVER);
	cfb_framebuffer_clear(epd_dev, true);

	// if node is not provisioned 
	if (!mesh_is_initialized() || !mesh_is_prov_complete())
	{
		len = snprintf(str, sizeof(str), "Mesh Info :\n");
		print_line(FONT_SMALL, line++, str, len, true);

		len = snprintf(str, sizeof(str), "Name : Unassigned\n");
		print_line(FONT_SMALL, line++, str, len, false);

		char device_uuid_str[8+1];
		bin2hex(get_my_device_uuid() , 2 , device_uuid_str, sizeof(device_uuid_str));
		len = snprintf(str, sizeof(str), "UUID : %s", device_uuid_str);
		print_line(FONT_SMALL, line++, str, len, false);

		len = snprintf(str, sizeof(str), "Address : %s", "Unassigned");
		print_line(FONT_SMALL, line++, str, len, false);

		len = snprintf(str, sizeof(str), "Status : Advertising\n");
		print_line(FONT_SMALL, line++, str, len, false);
	}
	// if node is provisioned 
	else if (mesh_is_initialized() && mesh_is_prov_complete())
	{

		len = snprintf(str, sizeof(str), "Mesh Info :\n");
		print_line(FONT_SMALL, line++, str, len, true);

		len = snprintf(str, sizeof(str), "Name : %s", get_my_device_name());
		print_line(FONT_SMALL, line++, str, len, false);

		char device_uuid_str[8+1];
		bin2hex(get_my_device_uuid() , 2 , device_uuid_str, sizeof(device_uuid_str));
		len = snprintf(str, sizeof(str), "UUID : %s", device_uuid_str);
		print_line(FONT_SMALL, line++, str, len, false);

		len = snprintf(str, sizeof(str), "Address : 0x%04x\n", get_my_address());
		print_line(FONT_SMALL, line++, str, len, false);

		len = snprintf(str, sizeof(str), "Status : Provisioned\n");
		print_line(FONT_SMALL, line++, str, len, false);
	}
	
	len = snprintf(str, sizeof(str), "Temperature : %d C \n", get_temperature());
	print_line(FONT_SMALL, line++, str, len, false);

	len = snprintf(str, sizeof(str), "Humidity : %d%%\n",get_humidity());
	print_line(FONT_SMALL, line++, str, len, false);

	cfb_framebuffer_finalize(epd_dev);
}

/* return node_info list record count */
static int get_node_info_list_record_count()
{
	return record_count;
}

/* print node_info list info on the board */
void show_node_status()
{
	char str[100];
	int len, line = 0;
	epd_dev = device_get_binding(DISPLAY_DRIVER);
	cfb_framebuffer_clear(epd_dev, true);

	 // print my info
	len = snprintf(str, sizeof(str), "Node :%s: 0x%04x :%dC %d%% \n",
									 get_my_device_name(), get_my_address(), get_temperature(), get_humidity());
	print_line(FONT_SMALL, line++, str, len, true);

	// print my neighbours info
	len = snprintf(str, sizeof(str), "%s", "My Neighbours: \n");
	print_line(FONT_SMALL, line++, str, len, true);

	for (int i = 0; i < get_node_info_list_record_count(); i++)
	{
		struct stat *stat = &node_info[i];
		if (stat->addr != BT_MESH_ADDR_UNASSIGNED)
		{
			if (stat->addr == get_my_address())
			{
				char temp_hum[50];
				if (stat->neighbour_temperature >= 0 && stat->neighbour_humidity >= 0)
					snprintf(temp_hum, 50, "%dC %d%%", stat->neighbour_temperature, stat->neighbour_humidity);
				else
					snprintf(temp_hum, 20, "%s", "");
				int8_t round_result = (int8_t) round(stat->distance); 
				len = snprintf(str, sizeof(str), "%s:0x%04x %dm %d %s\n",
								   stat->neighbour_name, stat->neighbour_addr, round_result,stat->rssi,
								    temp_hum);
				print_line(FONT_SMALL, line++, str, len, false);
			}
		}
	}

	// print neighbours neighbours Info
	if(get_node_info_list_record_count() > 1)
	{
		len = snprintf(str, sizeof(str), "%s", "-----------------------\n");
		print_line(FONT_SMALL, line++, str, len, false);

		len = snprintf(str, sizeof(str), "%s", "Among Neighbours: \n");
		print_line(FONT_SMALL, line++, str, len, true);
	
		for (int i = 0; i < get_node_info_list_record_count(); i++)
		{
			struct stat *stat = &node_info[i];
			if (stat->addr != BT_MESH_ADDR_UNASSIGNED)
			{
				if (stat->addr != get_my_address())
				{
					int8_t round_result =  (int8_t) round(stat->distance); 
					len = snprintf(str, sizeof(str), "%s:0x%04x %s:0x%04x %dm\n",
								stat->name, stat->addr,
								stat->neighbour_name, stat->neighbour_addr, round_result);
					print_line(FONT_SMALL, line++, str, len, false);
				}
			}
		}
	}
	cfb_framebuffer_finalize(epd_dev);
}

/* check if record already exists in node_info list */
static bool check_if_record_exists(uint16_t address_hex)
{
	if(address_hex != BT_MESH_ADDR_UNASSIGNED && address_hex != get_my_address())
	{
		int is_record_exists = 0;
		for (int i = 0; i <  get_node_info_list_record_count(); i++)
		{
			struct stat *stat = &node_info[i];
			if (stat->addr == get_my_address())
			{
				if (stat->neighbour_addr == address_hex)
				{
					is_record_exists = 1;
					return is_record_exists;
				}
			}
		}
		return is_record_exists;
	}
	else
		return 1;
}

/* check if  neighbour record already exists in node_info list */
static bool check_if_record_neighbour_exists(uint16_t ctx_addr, uint16_t address_hex)
{
	int is_record_exists = 0;
	for (int i = 0; i <  get_node_info_list_record_count(); i++)
	{
		struct stat *stat = &node_info[i];
		if (address_hex != get_my_address() && ((stat->addr == ctx_addr && stat->neighbour_addr == address_hex) ||
											 (stat->neighbour_addr == ctx_addr && stat->addr == address_hex)))
		{
			is_record_exists = 1;
			return is_record_exists;
		}
	}
	return is_record_exists;
}


void board_add_node_and_neighbours_data(uint16_t from_address, char * message_str, double distance, int16_t rssi)
{
	// if message is of type "Provisioning Message" with message code as Q , 
	// then add record of node and provisioner as node's neigbour in node_info list
	if (strstr(message_str, "Q") != NULL) 
	{
		record_count = 0;
		struct stat *self_stat = &node_info[record_count];
		snprintf(self_stat->name, 3, "%s", get_my_device_name());
		char msg_str[20];
		snprintf(msg_str, 20, "%s", message_str);
		char *msg_token = strtok(msg_str, "=");
		msg_token = strtok(NULL, "=");
		snprintf(self_stat->neighbour_name, 4, "%s", get_provisioner_device_name());
		self_stat->addr = get_my_address();
		self_stat->humidity = get_humidity();
		self_stat->temperature = get_temperature();
		self_stat->neighbour_addr = from_address;
		self_stat->rssi = rssi;
		self_stat->distance = distance;
		record_count++;
	}

	//if message is of type "Neighbours Info Message" with message code as R , 
	// then add the record for node and extracted address as node's neigbour in node_info list
	if (strstr(message_str, "R") != NULL) 
	{
		char msg_str[20];
		snprintf(msg_str, 20, "%s", message_str);
		char *address_name_token;
		char address_str[7];
		address_name_token = strtok(msg_str, "=");
		address_name_token = strtok(NULL, "=");
		snprintf(address_str,7,"0X000%s",address_name_token);
		uint16_t address_hex = (uint16_t)strtol(address_str, NULL, 0);
		int is_record_exists = check_if_record_exists(address_hex);
		
		if (is_record_exists == 0)
		{
			struct stat *self_stat = &node_info[record_count];
			self_stat->addr = get_my_address();
			snprintf(self_stat->name, 3, "%s", get_my_device_name());
			self_stat->distance = self_stat->distance ;
			self_stat->humidity = get_humidity();
			self_stat->temperature = get_temperature();
			self_stat->addr = get_my_address();
			self_stat->rssi = self_stat->rssi ;
			self_stat->neighbour_addr = address_hex;
			address_name_token = strtok(NULL, "=");
			snprintf(self_stat->neighbour_name, 4, "%s", address_name_token);
			record_count++;
		}
	}

	// update distance and rssi value in node_info list with respect to neighbour with address as from_address
	for (int i = 0; i <  get_node_info_list_record_count(); i++)
	{
		struct stat *stat = &node_info[i];
		if (stat->addr == get_my_address())
		{
			if (stat->neighbour_addr == from_address)
			{
				stat->distance = distance;
				stat->rssi = rssi;
			}
		}
	}

	//if message is of type "Sensor Info Message" with message code as S, 
	// then save sensor info of neighbor with address as from_address
	if(strstr(message_str,"S")!=NULL) 
	{
		for (int i = 0; i <  get_node_info_list_record_count(); i++)
		{
			struct stat *stat = &node_info[i];
			if (stat->addr == get_my_address())
			{
				if (stat->neighbour_addr == from_address)
				{
					char msg_str[50];
					snprintf(msg_str, 50, "%s", message_str);
					char *msg_token;
					msg_token = strtok(msg_str, "=");
					msg_token = strtok(NULL, "=");
					snprintk(stat->neighbour_name, 4, "%s", msg_token);
					msg_token = strtok(NULL, "=");
					stat->neighbour_temperature = atoi(msg_token);
					msg_token = strtok(NULL, "=");
					stat->neighbour_humidity= atoi(msg_token);
					stat->rssi = rssi;
					stat->distance = distance;
				}
			}
		}
	}

	//if message is of type "Neighbours Neighbours Message" with message code as T, 
	// then add a recors of it in node_info list
	if(strstr(message_str,"T")!=NULL)
	{
		char msg_str[20];
		snprintf(msg_str, 20, "%s", message_str);
		char *address_name_token;
		char address_str[7];
		address_name_token = strtok(msg_str, "=");
		address_name_token = strtok(NULL, "=");
		snprintf(address_str,7,"0X000%s",address_name_token);
		uint16_t address_hex = (uint16_t)strtol(address_str, NULL, 0);
		if(address_hex!= BT_MESH_ADDR_UNASSIGNED)
		{
			int is_record_exists = check_if_record_neighbour_exists(from_address,address_hex);
			
			if (is_record_exists==0) 
			{
				struct stat *stat = &node_info[record_count];
				stat->addr = from_address;
				stat->neighbour_addr = address_hex;
				address_name_token = strtok(NULL, "=");
				snprintf(stat->neighbour_name, 4, "%s", address_name_token);
				record_count++;
			}
		}	
	}

	//if message is of type "Neighbours Neighbours Update Info Message" with message code as U, 
	// update received info to corresponding neighbor neighbour record in node_info list
	if(strstr(message_str,"U")!=NULL)
	{
		char msg_str[20];
		snprintf(msg_str, 20, "%s", message_str);
		char *address_name_token;
		char address_str[7];
		address_name_token = strtok(msg_str, "=");
		address_name_token = strtok(NULL, "=");
		snprintf(address_str,7,"0X000%s",address_name_token);
		uint16_t address_hex = (uint16_t)strtol(address_str, NULL, 0);
		int is_record_exists = check_if_record_neighbour_exists(from_address, address_hex);
		if (is_record_exists == 1)
		{
			for (int i = 0; i <  get_node_info_list_record_count(); i++)
			{
				struct stat *stat = &node_info[i];
				if(stat->addr == from_address && stat->addr  != get_my_address() &&  stat->neighbour_addr == address_hex)
				{
					address_name_token = strtok(NULL, "=");
					int8_t round_value = atoi(address_name_token);
					stat->distance = round_value ;
					address_name_token = strtok(NULL, "=");
					snprintf(stat->name, 3, "%s", address_name_token);
				}
			}
		}
	}
	
	// send sensor Info , Neighbours Neighbours Info  stores in node_info list to all my neighbours
	for (int i = 0; i < get_node_info_list_record_count() ; i++) 
	{
		struct stat *stat = &node_info[i];
		if(stat->addr == get_my_address())
		{
			char sensor_info_message[12];
			snprintf(sensor_info_message, 12, "S=%s=%d=%d", get_my_device_name(),get_temperature(), get_humidity());
			send_message(stat->neighbour_addr, sensor_info_message);	

			if(stat->neighbour_addr != from_address)
			{
				char addr_string[8];
				snprintf(addr_string,8,"0x%04x",stat->neighbour_addr);
				char c = addr_string[strlen(addr_string) -1];

				char neighbour_addr_name_msg[10];
				snprintf(neighbour_addr_name_msg,10,"T=%c=%s",c,stat->neighbour_name);						
				send_message(from_address,neighbour_addr_name_msg);
								
				char neighbour_addr_dist_message[17],dev_name[4];
				snprintf(dev_name, 4, "%s",get_my_device_name());
				int8_t round_result = (int8_t) round(stat->distance); 
				snprintf(neighbour_addr_dist_message, 17, "U=%c=%d=%s", c,round_result,dev_name);
				send_message(from_address,neighbour_addr_dist_message);	
			}	
		}
			
	}

	// print all reciors of node_info list on serial log 
	printk ("Record No. : Node_Address Node_Name  Node_Temperature  Node_Humidity Neighbour_Address Neighbour_Name Neighbour_Temperature Neighbour_Humidity Distance Rssi\n ");
	for (int i = 0; i < get_node_info_list_record_count() ; i++) {
	struct stat *stat = &node_info[i];
	printk ("Record %d : 0x%04x %s %dC %d%%    0x%04x %s %dC %d%%    %dm %d\n ",
			i+1 ,stat->addr, stat->name, stat->temperature,stat->humidity,
			stat->neighbour_addr , stat->neighbour_name,stat->neighbour_temperature,stat->neighbour_humidity,
			stat->distance,stat->rssi);
	}
	printk("\n ");

	//display node_info list info on board
	show_node_status();
}

/*blink board leds lights */
void board_blink_leds(void)
{
	k_delayed_work_submit(&led_timer, K_MSEC(100));
}

/*set led state */
int set_led_state(uint8_t id, bool state)
{
	return gpio_pin_set(leds[id].dev, leds[id].pin, state);
}

/* set led timeout */
static void led_timeout(struct k_work *work)
{
	static int led_cntr;
	int i;

	// Disable all LEDs
	for (i = 0; i < ARRAY_SIZE(leds); i++) {
		set_led_state(i, 0);
	}

	// Stop after 5 iterations
	if (led_cntr >= (ARRAY_SIZE(leds) * 5)) {
		led_cntr = 0;
		return;
	}

	// Select and enable current LED 
	i = led_cntr++ % ARRAY_SIZE(leds);
	set_led_state(i, 1);

	k_delayed_work_submit(&led_timer, K_MSEC(100));
}

/* configure board leds */
static int configure_leds(void)
{
	for (int i = 0; i < ARRAY_SIZE(leds); i++) {
		leds[i].dev = device_get_binding(leds[i].name);
		if (!leds[i].dev) {
			return -ENODEV;
		}
		gpio_pin_configure(leds[i].dev, leds[i].pin,
				   leds[i].flags | GPIO_OUTPUT_INACTIVE);
	}
	k_delayed_work_init(&led_timer, led_timeout);
	return 0;
}

/*show text on board display */
void board_show_text(const char * message_str, bool center)
{
	int line = 0;
	epd_dev = device_get_binding(DISPLAY_DRIVER);
	cfb_framebuffer_clear(epd_dev, true);
	print_line(FONT_SMALL, line++, message_str, strlen(message_str), center);
	cfb_framebuffer_finalize(epd_dev);
}

/*initialize device board */
void board_init(void)
{
	epd_dev = device_get_binding(DISPLAY_DRIVER);	
	cfb_framebuffer_init(epd_dev) ;
	cfb_framebuffer_clear(epd_dev, true);
	configure_leds();
}
```
