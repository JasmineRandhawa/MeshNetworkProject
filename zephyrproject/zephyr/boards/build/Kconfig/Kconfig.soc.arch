## zephyrproject/zephyr/boards/build/Kconfig/Kconfig.soc.arch
```kconfig
osource "C:/Fall2020/Projects/7570/MeshProject/zephyrproject/zephyr/soc/$(ARCH)/Kconfig"
osource "C:/Fall2020/Projects/7570/MeshProject/zephyrproject/zephyr/soc/$(ARCH)/*/Kconfig"
```

## zephyrproject/zephyr/build/Kconfig/Kconfig.soc
```kconfig
osource "C:/Fall2020/Projects/7570/MeshNetworkProject/zephyrproject/zephyr/soc/$(ARCH)/*/Kconfig.soc"
```

## zephyrproject/zephyr/build/Kconfig/Kconfig.soc.arch
```kconfig
osource "C:/Fall2020/Projects/7570/MeshNetworkProject/zephyrproject/zephyr/soc/$(ARCH)/Kconfig"
osource "C:/Fall2020/Projects/7570/MeshNetworkProject/zephyrproject/zephyr/soc/$(ARCH)/*/Kconfig"
```
